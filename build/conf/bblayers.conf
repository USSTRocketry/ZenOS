## build/conf/bblayers.conf
```bitbake
# POKY_BBLAYERS_CONF_VERSION is increased each time build/conf/bblayers.conf
# changes incompatibly
POKY_BBLAYERS_CONF_VERSION = "2"

BBPATH = "${TOPDIR}"
BBFILES ?= ""

BBLAYERS ?= " \
  ${ZENOS_PROJ_DIR}/poky/meta \
  ${ZENOS_PROJ_DIR}/poky/meta-poky \
  ${ZENOS_PROJ_DIR}/poky/meta-yocto-bsp \
  ${ZENOS_PROJ_DIR}/meta-raspberrypi \
  ${ZENOS_PROJ_DIR}/meta-openembedded/meta-oe \
  ${ZENOS_PROJ_DIR}/meta-openembedded/meta-python \
  ${ZENOS_PROJ_DIR}/meta-openembedded/meta-xfce \
  ${ZENOS_PROJ_DIR}/meta-openembedded/meta-gnome \
  ${ZENOS_PROJ_DIR}/meta-openembedded/meta-networking \
  ${ZENOS_PROJ_DIR}/meta-openembedded/meta-multimedia \
  ${ZENOS_PROJ_DIR}/meta-rauc \
  ${ZENOS_PROJ_DIR}/meta-rauc-community/meta-rauc-raspberrypi \
  ${ZENOS_PROJ_DIR}/meta-groundstation \
  ${ZENOS_PROJ_DIR}/meta-security \
  "
```
