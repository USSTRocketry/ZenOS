## meta-groundstation/conf/layer.conf
```bitbake
LICENSE_FLAGS_ACCEPTED += "synaptics-killswitch"

# We have a conf and classes directory, add to BBPATH
BBPATH .= ":${LAYERDIR}"

#MACHINE = "raspberrypi4-64"
MACHINE = "raspberrypi3-64"
IMAGE_FSTYPES="tar.bz2 ext4 wic.bz2 wic.bmap"
PACKAGE_CLASSES ?= "package_ipk"
EXTRA_IMAGE_FEATURES = "debug-tweaks ssh-server-openssh"
INHERIT += "extrausers"
#EXTRA_USERS_PARAMS = "usermod -P /etc/shadow AV@USST root;"
hostname:pn-base-files = "phoenix"
IMAGE_FEATURES:remove = "splash"
DISABLE_SPLASH = "1"

DISTRO_FEATURES:append = " systemd usrmerge rauc pam wifi"
VIRTUAL-RUNTIME_init_manager = "systemd"
VIRTUAL-RUNTIME_network_manager = "systemd-networkd"
DISTRO_FEATURES_BACKFILL_CONSIDERED = "sysvinit"
VIRTUAL-RUNTIME_initscripts = ""
SDIMG_ROOTFS_TYPE="ext4"

RPI_USE_U_BOOT = "1"
PREFERRED_PROVIDER_virtual/bootloader = "u-boot"
WKS_FILE = "sdimage-dual-raspberrypi.wks.in"

# We have recipes-* directories, add to BBFILES
BBFILES += "${LAYERDIR}/recipes-*/*/*.bb \
            ${LAYERDIR}/recipes-*/*/*.bbappend"

BBFILE_COLLECTIONS += "meta-groundstation"
BBFILE_PATTERN_meta-groundstation = "^${LAYERDIR}/"
BBFILE_PRIORITY_meta-groundstation = "6"

LAYERDEPENDS_meta-groundstation = "core"
LAYERSERIES_COMPAT_meta-groundstation = "scarthgap"


# Versioning magic
PREFERRED_VERSION_python3-adafruit-blinka = "rpi3"
PREFERRED_VERSION_python3-adafruit-platformdetect = "3.79.0"
```
